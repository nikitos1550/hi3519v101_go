#include <stdio.h>
#include <string.h>
#include <sys/types.h>
#include <sys/stat.h>
#include <sys/ioctl.h>
#include <fcntl.h>
#include <unistd.h>
#include "hi_comm_video.h"

#include "hi_spi.h"


extern WDR_MODE_E genSensorMode;
extern HI_U8 gu8SensorImageMode;
extern HI_BOOL bSensorInit;

static int g_fd= -1;

void sensor_wdr_1080p30f_init(void);
void sensor_linear_1080p30f_init(void);

int sensor_spi_init(void)
{
    if (g_fd >= 0)
    {
        return 0;
    }     
    unsigned int value;
    int ret = 0;
    char file_name[] = "/dev/spidev0.0";

    g_fd = open(file_name, 0);
    if (g_fd < 0)
    {
        printf("Open %s error!\n",file_name);
        return -1;
    }

    value = SPI_MODE_3 | SPI_LSB_FIRST;// | SPI_LOOP;
    ret = ioctl(g_fd, SPI_IOC_WR_MODE, &value);
    if (ret < 0)
    {
        printf("ioctl SPI_IOC_WR_MODE err, value = %d ret = %d\n", value, ret);
        return ret;
    }

    value = 8;
    ret = ioctl(g_fd, SPI_IOC_WR_BITS_PER_WORD, &value);
    if (ret < 0)
    {
        printf("ioctl SPI_IOC_WR_BITS_PER_WORD err, value = %d ret = %d\n",value, ret);
        return ret;
    }

    value = 2000000;
    ret = ioctl(g_fd, SPI_IOC_WR_MAX_SPEED_HZ, &value);
    if (ret < 0)
    {
        printf("ioctl SPI_IOC_WR_MAX_SPEED_HZ err, value = %d ret = %d\n",value, ret);
        return ret;
    }

    return 0;
}

int sensor_spi_exit(void)
{
    if (g_fd >= 0)
    {
        close(g_fd);
        g_fd = -1;
        return 0;
    }
    return -1;
}

int sensor_write_register(unsigned int addr, unsigned char data)
{
    int ret;
    struct spi_ioc_transfer mesg[1];
    unsigned char  tx_buf[8] = {0};
    unsigned char  rx_buf[8] = {0};
    
    tx_buf[0] = (addr & 0xff00) >> 8;
    tx_buf[0] &= (~0x80);
    tx_buf[1] = addr & 0xff;
    tx_buf[2] = data;

    memset(mesg, 0, sizeof(mesg));  
    mesg[0].tx_buf = (__u32)tx_buf;  
    mesg[0].len    = 3;  
    mesg[0].rx_buf = (__u32)rx_buf; 
    mesg[0].cs_change = 1;

    ret = ioctl(g_fd, SPI_IOC_MESSAGE(1), mesg);
    if (ret < 0) {  
        printf("SPI_IOC_MESSAGE error \n");  
        return -1;  
    }

    return 0;
}

int sensor_read_register(unsigned int addr)
{
    int ret = 0;
    struct spi_ioc_transfer mesg[1];
    unsigned char  tx_buf[8] = {0};
    unsigned char  rx_buf[8] = {0};
    
    tx_buf[0] = (addr & 0xff00) >> 8;
    tx_buf[0] |= 0x80;
    tx_buf[1] = addr & 0xff;
    tx_buf[2] = 0;

    memset(mesg, 0, sizeof(mesg));
    mesg[0].tx_buf = (__u32)tx_buf;
    mesg[0].len    = 3;
    mesg[0].rx_buf = (__u32)rx_buf;
    mesg[0].cs_change = 1;

    ret = ioctl(g_fd, SPI_IOC_MESSAGE(1), mesg);
    if (ret  < 0) {  
        printf("SPI_IOC_MESSAGE error \n");  
        return -1;  
    }
    
    return rx_buf[2];
}

static void delay_ms(int ms) { 
    usleep(ms*1000);
}

void sensor_prog(int* rom) 
{
    int i = 0;
    while (1) {
        int lookup = rom[i++];
        int addr = (lookup >> 16) & 0xFFFF;
        int data = lookup & 0xFFFF;
        if (addr == 0xFFFE) {
            delay_ms(data);
        } else if (addr == 0xFFFF) {
            return;
        } else {
            sensor_write_register(addr, data);
        }
    }
}



void sensor_init()
{
	printf("sensor_init\n");
    bSensorInit = HI_TRUE;
    /* 1. sensor spi init */
    sensor_spi_init();
	if( WDR_MODE_NONE == genSensorMode )
	{
		sensor_linear_1080p30f_init();
	}
	else if(WDR_MODE_2To1_LINE == genSensorMode)
    {
		sensor_wdr_1080p30f_init();
	}
	else
	{
		printf("Not support this mode\n");
		bSensorInit = HI_FALSE;
	}

}

void sensor_exit()
{
    sensor_spi_exit();
	bSensorInit = HI_FALSE;
    return;
}
void Sensor_LoadRegSetting(const int table[][2])
{
	int reg,val;
	int i = 0;
	while(1)
	{
		reg = table[i][0];
		val = table[i][1];

		if(reg == 0xFFFE)
		{
			delay_ms(val);
		}
		else if((reg == 0xFFFF) && (val == 0xFF))
		{
			break;
		}
		else{
			sensor_write_register(reg, val); 
		}
		i++;
	}
	return;
}
static const int Sensor_imx290_1080p30f_DOL_WDR_table_LVDS_10BIT[][2]=
{
	0x0200,	0x01,
	0x0201,	0x00,
	0x0202,	0x01,
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	0x0217,	0x00,
	//VMAX
	0x0218,	0x94,
	0x0219,	0x05,
	0x021A,	0x00,
	0x021B,	0x00,
	//HMAX
	0x021C,	0x20,
	0x021D,	0x08,
	0x021E,	0xB2,
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	0xFFFF, 0xFF,//end flag
};
static const int Sensor_imx290_1080p30f_DOL_WDR_table_LVDS_12BIT[][2]=
{
	0x0200,	0x01,
	0x0201,	0x00,
	0x0202,	0x01,
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	0x0217,	0x00,
	//VMAX
	0x0218,	0xE2,
	0x0219,	0x04,
	0x021A,	0x00,
	0x021B,	0x00,
	//HMAX
	0x021C,	0xBC,
	0x021D,	0x07,
	0x021E,	0xB2,
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	0xFFFF, 0xFF,//end flag
};

static const int Sensor_imx290_1080p30f_NORMAL_table_LVDS_10BIT[][2]=
{
	0x0200,	0x01,
	0x0201,	0x00,
	0x0202,	0x01,
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	0x0243,	0x07,
	//0x0245,	0x03,
	0x0246,	0xE0,
	0x0247,	0x01,
	0x0248,	0x00,
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	0x02B0,	0x43,

	//0x0306, 0x1a,
	0x0319, 0x9E,
	0x031C, 0x1E,
	0x031D, 0x00,
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	0xFFFF, 0xFF,//end flag
};
static const int Sensor_imx290_1080p30f_NORMAL_table_LVDS_12BIT[][2]=
{
	0x0200,	0x01,
	0x0201,	0x00,
	0x0202,	0x01,
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	0x0243,	0x07,
	//0x0245,	0x03,
	0x0246,	0xE1,
	0x0247,	0x01,
	0x0248,	0x00,
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	0x02B0,	0x43,

	//0x0306, 0x1a,
	0x0319, 0x9E,
	0x031C, 0x1E,
	0x031D, 0x00,
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	0xFFFF, 0xFF,//end flag
};

static const int Sensor_imx290_1080p30f_DOL_WDR_table_MIPI_12BIT[][2]=
{
	0x0200,	0x01,
	0x0201,	0x00,
	0x0202,	0x01,
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	0xFFFF, 0xFF,//end flag
};

static const int Sensor_imx290_1080p30f_NORMAL_table_MIPI_12BIT[][2]=
{
	0x0200,  0x01,
	0x0201,  0x00,
	0x0202,  0x01,
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	0xFFFF, 0xFF,//end flag
};

void sensor_wdr_1080p30f_init(void)
{
    
	//Sensor_LoadRegSetting(Sensor_imx290_1080p30f_DOL_WDR_table);
	Sensor_LoadRegSetting(Sensor_imx290_1080p30f_DOL_WDR_table_LVDS_10BIT);
    printf("-------Sony IMX290 Sensor 1080p 30fps DOL WDR Initial OK!-------\n");
}



void sensor_linear_1080p30f_init(void)
{
    //Sensor_LoadRegSetting(Sensor_imx290_1080p30f_table);
    Sensor_LoadRegSetting(Sensor_imx290_1080p30f_NORMAL_table_LVDS_10BIT);
    printf("-------Sony IMX290 Sensor 1080p 30fps Linear Initial OK!-------\n");
}

